#include "Display.h"


const unsigned char epd_bitmap_rower [] PROGMEM = {
	0x00, 0x00, 0x00, 0x00, 0x00, 0x00, 0x00, 0x00, 0x00, 0x00, 0x00, 0x00, 0x00, 0x00, 0x00, 0x00, 
	0x00, 0x00, 0x00, 0x00, 0x00, 0x00, 0x00, 0x00, 0x00, 0x00, 0x00, 0x00, 0x00, 0x00, 0x00, 0x00, 
	0x00, 0x00, 0x00, 0x00, 0x00, 0x00, 0x00, 0x00, 0x00, 0x00, 0x00, 0x00, 0x00, 0x00, 0x00, 0x00, 
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	0x00, 0x00, 0x00, 0x00, 0x00, 0x00, 0x00, 0x00
};

const unsigned char epd_bitmap_bluetooth [] PROGMEM = {
  0x00, 0x00, 0x00, 0x00, 0x00, 0x00, 0x00, 0x00, 0x00, 0x00, 0x00, 0x00, 0x00, 0x00, 0x00, 0x00, 
	0x00, 0x00, 0x00, 0x00, 0x00, 0x00, 0x00, 0x00, 0x00, 0x00, 0x00, 0x00, 0x00, 0x00, 0x00, 0x03, 
	0x80, 0x00, 0x00, 0x00, 0x00, 0x00, 0x00, 0x00, 0x00, 0x00, 0x00, 0x00, 0x0f, 0xe0, 0x00, 0x00, 
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	0x00, 0x00, 0x00, 0x00
};

DisplayManager::DisplayManager() : display(GxEPD2_270(EPD_CS, EPD_DC, EPD_RST, EPD_BUSY)) {}

void DisplayManager::init() {
    display.init(115200);
    display.setRotation(3);
}

void DisplayManager::drawSetupScreen(bool sdOK, bool mpuOK, int sats, String debugMsg, uint32_t searchTimeSec) {
    display.setFullWindow();
    display.firstPage();
    do {
        display.fillScreen(GxEPD_WHITE);
        display.setTextColor(GxEPD_BLACK);
        
        // --- LEFT COLUMN: System Status ---
        display.setTextSize(2);
        display.setCursor(5, 20); 
        display.print("SpeedCoach");

        display.setTextSize(1);
        display.setCursor(5, 55); 
        display.print("SD Card: "); 
        display.print(sdOK ? "OK" : "ERROR");
        
        display.setCursor(5, 75); 
        display.print("IMU Sensor: "); 
        display.print(mpuOK ? "OK" : "ERROR");
        
        display.setCursor(5, 95); 
        display.print("Satellites: "); 
        display.print(sats);

        display.setCursor(5, 125); 
        display.print("Status: ");
        display.setCursor(5, 140); 
        display.print(debugMsg);

        display.setCursor(5, 160); 
        display.print("Elapsed: ");
        display.print(searchTimeSec);
        display.print(" sec");

        // --- RIGHT COLUMN: Image Graphic ---
        display.drawBitmap(120, 30, epd_bitmap_rower, 120, 120, GxEPD_BLACK);

    } while (display.nextPage());
}

void DisplayManager::drawBackground() {
    display.setFullWindow();
    display.firstPage();
    do {
        display.fillScreen(GxEPD_WHITE);
        display.setTextColor(GxEPD_BLACK);
        
        // Top bar is shared between both UIs
        display.drawLine(0, 26, display.width(), 26, GxEPD_BLACK);
        
        if (useClassicUI) {
            int midX = display.width() / 2;
            int midY = ((display.height() - 26) / 2) + 26;
            display.drawLine(midX, 26, midX, display.height(), GxEPD_BLACK);
            display.drawLine(0, midY, display.width(), midY, GxEPD_BLACK);
            
            display.setTextSize(1);
            display.setCursor(5, 30); display.print("Split");
            display.setCursor(midX + 5, 30); display.print("Stroke Rate");
            display.setCursor(5, midY + 5); display.print("Distance");
            display.setCursor(midX + 5, midY + 5); display.print("Time");
            display.setCursor(midX - 35, 30); display.print("/500m");
            display.setCursor(display.width() - 25, 30); display.print("spm");
            display.setCursor(midX - 15, midY + 5); display.print("m");
            display.setCursor(display.width() - 25, midY + 5); display.print("min");
        } else {
            int midX = 110; // Left column width (gives curve more space)
            int midY = ((display.height() - 26) / 2) + 26;
            int ratioY = display.height() - 25; // Bottom section for ratio

            display.drawLine(midX, 26, midX, display.height(), GxEPD_BLACK); // Vertical split
            display.drawLine(0, midY, midX, midY, GxEPD_BLACK);              // Left horizontal
            display.drawLine(midX, ratioY, display.width(), ratioY, GxEPD_BLACK); // Right horizontal
            
            display.setTextSize(1);
            display.setCursor(5, 30); display.print("Split /500m");
            display.setCursor(5, midY + 5); display.print("Stroke Rate");
            display.setCursor(midX + 5, ratioY + 5); display.print("Ratio:");
        }
    } while (display.nextPage());
}

void DisplayManager::updateMainScreen(float avgSpeed, float dist, float minutes, int sats, float currentSpm, int hour, int minute, float* avgCurve, float ratio) {
    int splitMin = 0, splitSec = 0;
    if (avgSpeed > 0.5) {
        float totalSecFor500m = 1800.0 / avgSpeed; 
        splitMin = (int)(totalSecFor500m / 60);
        splitSec = (int)(totalSecFor500m) % 60;
    }
    String status = (currentSpm > 0) ? "ROWING" : "STATIONARY";
    
    // Coordinate Helpers
    int classicMidX = display.width() / 2;
    int classicMidY = ((display.height() - 25) / 2) + 25;
    int newMidX = 110;
    int newMidY = ((display.height() - 26) / 2) + 26;

    // 1. TOP BAR (Shared)
    if (sats != lastDispSats || status != lastDispStatus) {
        char timeBuf[6]; sprintf(timeBuf, "%02d:%02d", hour, minute);
        display.setPartialWindow(0, 0, display.width(), 20);
        display.firstPage();
        do {
            display.fillScreen(GxEPD_WHITE);
            display.setTextSize(1);
            display.setCursor(5, 8); display.print("Sats: "); display.print(sats);
            display.setCursor(display.width() - 40, 8); display.print(timeBuf);
            int16_t x1, y1; uint16_t w, h;
            display.setTextSize(2);
            display.getTextBounds(status, 0, 0, &x1, &y1, &w, &h);
            display.setCursor((display.width()/2)-(w/2), 6); display.print(status);
        } while (display.nextPage());
        lastDispSats = sats; lastDispStatus = status;
    }

    // 2. SPLIT/PACE
    if (splitMin != lastDispSplitMin || splitSec != lastDispSplitSec) {
        int wX = 0, wY = 42, wW = (useClassicUI) ? classicMidX - 20 : newMidX - 5, wH = 40;
        display.setPartialWindow(wX, wY, wW, wH); 
        display.firstPage();
        do {
            display.fillScreen(GxEPD_WHITE);
            display.setTextSize(3); display.setCursor(10, 50); 
            if (avgSpeed > 0.5) {
                display.print(splitMin); display.print(":");
                if (splitSec < 10) {
                    display.print("0");
                }
                display.print(splitSec);
            } else { display.print("--:--"); }
        } while (display.nextPage());
        lastDispSplitMin = splitMin; lastDispSplitSec = splitSec;
    }

    // 3. STROKE RATE
    if ((int)currentSpm != (int)lastDispSpm) {
        int wX = (useClassicUI) ? classicMidX + 10 : 0;
        int wY = (useClassicUI) ? 42 : newMidY + 23;
        int wW = (useClassicUI) ? classicMidX - 45 : newMidX - 5;
        int wH = 40;
        
        display.setPartialWindow(wX, wY, wW, wH); 
        display.firstPage();
        do {
            display.fillScreen(GxEPD_WHITE); display.setTextSize(4);
            int curX = (useClassicUI) ? classicMidX + 20 : 15;
            int curY = (useClassicUI) ? 50 : newMidY + 30;
            display.setCursor(curX, curY); display.print((int)currentSpm);
        } while (display.nextPage());
        lastDispSpm = (int)currentSpm;
    }

    // 4. CLASSIC UI: DISTANCE & TIME
    if (useClassicUI) {
        if ((int)dist != lastDispDist) {
            display.setPartialWindow(10, classicMidY + 23, classicMidX - 35, 40); 
            display.firstPage();
            do {
                display.fillScreen(GxEPD_WHITE); display.setTextSize(4);
                display.setCursor(15, classicMidY + 30); display.print((int)dist);
            } while (display.nextPage());
            lastDispDist = (int)dist;
        }

        if ((int)minutes != lastDispMin) {
            display.setPartialWindow(classicMidX + 10, classicMidY + 23, classicMidX - 50, 40); 
            display.firstPage();
            do {
                display.fillScreen(GxEPD_WHITE); display.setTextSize(4);
                display.setCursor(classicMidX + 20, classicMidY + 30); display.print((int)minutes);
            } while (display.nextPage());
            lastDispMin = (int)minutes;
        }
    } 
    // 5. NEW UI: CURVE & RATIO
    else {
        // ALWAYS redraw the graph if we have an array, so the user sees live technique changes
        if (avgCurve != nullptr && currentSpm > 0) {
            int ratioY = display.height() - 25;
            int boxX = newMidX + 1;
            int boxY = 27;
            int boxW = display.width() - newMidX - 1;
            int boxH = ratioY - 27;

            display.setPartialWindow(boxX, boxY, boxW, boxH);
            display.firstPage();
            do {
                display.fillScreen(GxEPD_WHITE);
                
                // Find min/max dynamically to scale the graph perfectly
                float minVal = avgCurve[0];
                float maxVal = avgCurve[0];
                for (int i = 1; i < 100; i++) {
                    if (avgCurve[i] < minVal) minVal = avgCurve[i];
                    if (avgCurve[i] > maxVal) maxVal = avgCurve[i];
                }
                
                float range = maxVal - minVal;
                if (range < 0.1f) range = 0.1f; // Prevent div by zero if flatline

                // Draw the 100-point curve
                for (int i = 0; i < 99; i++) {
                    int x1 = boxX + 5 + (i * (boxW - 10)) / 99;
                    int y1 = boxY + boxH - 5 - ((avgCurve[i] - minVal) / range) * (boxH - 10);
                    
                    int x2 = boxX + 5 + ((i + 1) * (boxW - 10)) / 99;
                    int y2 = boxY + boxH - 5 - ((avgCurve[i+1] - minVal) / range) * (boxH - 10);
                    
                    display.drawLine(x1, y1, x2, y2, GxEPD_BLACK);
                }
            } while (display.nextPage());
        }

        // Draw the Ratio Number
        if (abs(ratio - lastDispRatio) > 0.01) {
            int ratioY = display.height() - 25;
            display.setPartialWindow(newMidX + 50, ratioY + 2, display.width() - newMidX - 50, 20);
            display.firstPage();
            do {
                display.fillScreen(GxEPD_WHITE);
                display.setTextSize(2);
                display.setCursor(newMidX + 55, ratioY + 5);
                display.print(ratio, 2); // Print to 2 decimal places (e.g. "0.45")
            } while (display.nextPage());
            lastDispRatio = ratio;
        }
    }
}

void DisplayManager::drawBluetoothScreen() {
    display.setFullWindow();
    display.firstPage();
    do {
        display.fillScreen(GxEPD_WHITE);
        
        int logoX = (display.width() - 100) / 2;
        int logoY = (display.height() - 100) / 2;
        
        display.drawBitmap(logoX, logoY, epd_bitmap_bluetooth, 100, 100, GxEPD_BLACK);
        
    } while (display.nextPage());
}